## config/boards/shields/shapekey/Kconfig.defconfig
```kconfig
if SHIELD_SHAPEKEY_R

config ZMK_KEYBOARD_NAME
    default "shapekey_R"

config ZMK_SPLIT
    default y

config ZMK_SPLIT_ROLE_CENTRAL
    default y

 config PMW3610_REPORT_INTERVAL_MIN
    int "PMW3610 Report Interval (ms)"
    default 12

endif

if SHIELD_SHAPEKEY_L

config ZMK_KEYBOARD_NAME
    default "shapekey_L"

config ZMK_SPLIT
    default y

endif
```

## config/boards/shields/shapekey/Kconfig.shield
```kconfig
config SHIELD_SHAPEKEY_R
    def_bool $(shields_list_contains,shapekey_R)

config SHIELD_SHAPEKEY_L
    def_bool $(shields_list_contains,shapekey_L)
```

## config/west.yml
```yaml
manifest:
  remotes:
    - name: zmkfirmware
      url-base: https://github.com/petejohanson
    - name: inorichi
      url-base: https://github.com/inorichi
  projects:
    - name: zmk
      remote: zmkfirmware
      revision: feat/pointers-move-scroll
      import: app/west.yml
    - name: zmk-pmw3610-driver
      remote: inorichi
      revision: main
  self:
    path: config

  # manifest:
  # remotes:
  #   - name: zmkfirmware
  #     url-base: https://github.com/petejohanson
  #   - name: m-thw
  #     url-base: https://github.com/m-thw
  # projects:
  #   - name: zmk
  #     remote: zmkfirmware
  #     revision: feat/pointers-move-scroll
  #     import: app/west.yml
  #   - name: zmk-pmw3610-driver
  #     remote: m-thw 
  #     revision: main 
  # self:
  #   path: config
```
